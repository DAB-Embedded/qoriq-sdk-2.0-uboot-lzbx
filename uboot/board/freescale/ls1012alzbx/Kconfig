## uboot/board/freescale/ls1012alzbx/Kconfig
```kconfig
if TARGET_LS1012ALZBX

config SYS_BOARD
	default "ls1012alzbx"

config SYS_VENDOR
	default "freescale"

config SYS_SOC
	default "fsl-layerscape"

config SYS_CONFIG_NAME
	default "ls1012alzbx"

endif
```
